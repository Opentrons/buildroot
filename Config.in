## Config.in
```kconfig
# Toolchains
source "$BR2_EXTERNAL_OPENTRONS_BUILDROOT_OVERLAYS_PATH/toolchain/toolchain-external-linaro-arm-recent/Config.in.options"

# Target packages

source "$BR2_EXTERNAL_OPENTRONS_BUILDROOT_OVERLAYS_PATH/package/opentrons/Config.in"
source "$BR2_EXTERNAL_OPENTRONS_BUILDROOT_OVERLAYS_PATH/package/python-aiohttp/Config.in"
source "$BR2_EXTERNAL_OPENTRONS_BUILDROOT_OVERLAYS_PATH/package/python-aionotify/Config.in"
source "$BR2_EXTERNAL_OPENTRONS_BUILDROOT_OVERLAYS_PATH/package/python-anyio/Config.in"
source "$BR2_EXTERNAL_OPENTRONS_BUILDROOT_OVERLAYS_PATH/package/python-bleach/Config.in"
source "$BR2_EXTERNAL_OPENTRONS_BUILDROOT_OVERLAYS_PATH/package/python-fastapi/Config.in"
source "$BR2_EXTERNAL_OPENTRONS_BUILDROOT_OVERLAYS_PATH/package/python-fastjsonschema/Config.in"
source "$BR2_EXTERNAL_OPENTRONS_BUILDROOT_OVERLAYS_PATH/package/python-filetype/Config.in"
source "$BR2_EXTERNAL_OPENTRONS_BUILDROOT_OVERLAYS_PATH/package/python-httptools/Config.in"
source "$BR2_EXTERNAL_OPENTRONS_BUILDROOT_OVERLAYS_PATH/package/python-importlib-metadata/Config.in"
source "$BR2_EXTERNAL_OPENTRONS_BUILDROOT_OVERLAYS_PATH/package/python-ipykernel/Config.in"
source "$BR2_EXTERNAL_OPENTRONS_BUILDROOT_OVERLAYS_PATH/package/python-jupyter_client/Config.in"
source "$BR2_EXTERNAL_OPENTRONS_BUILDROOT_OVERLAYS_PATH/package/python-jupyter_core/Config.in"
source "$BR2_EXTERNAL_OPENTRONS_BUILDROOT_OVERLAYS_PATH/package/python-nbconvert/Config.in"
source "$BR2_EXTERNAL_OPENTRONS_BUILDROOT_OVERLAYS_PATH/package/python-nbclassic/Config.in"
source "$BR2_EXTERNAL_OPENTRONS_BUILDROOT_OVERLAYS_PATH/package/python-nbformat/Config.in"
source "$BR2_EXTERNAL_OPENTRONS_BUILDROOT_OVERLAYS_PATH/package/python-nest-asyncio/Config.in"
source "$BR2_EXTERNAL_OPENTRONS_BUILDROOT_OVERLAYS_PATH/package/python-notebook/Config.in"
source "$BR2_EXTERNAL_OPENTRONS_BUILDROOT_OVERLAYS_PATH/package/python-numpy/Config.in"
source "$BR2_EXTERNAL_OPENTRONS_BUILDROOT_OVERLAYS_PATH/package/python-pandas/Config.in"
source "$BR2_EXTERNAL_OPENTRONS_BUILDROOT_OVERLAYS_PATH/package/python-pandocfilters/Config.in"
source "$BR2_EXTERNAL_OPENTRONS_BUILDROOT_OVERLAYS_PATH/package/python-prometheus_client/Config.in"
source "$BR2_EXTERNAL_OPENTRONS_BUILDROOT_OVERLAYS_PATH/package/python-pydantic/Config.in"
source "$BR2_EXTERNAL_OPENTRONS_BUILDROOT_OVERLAYS_PATH/package/python-pydantic-core/Config.in"
source "$BR2_EXTERNAL_OPENTRONS_BUILDROOT_OVERLAYS_PATH/package/python-pydantic-settings/Config.in"
source "$BR2_EXTERNAL_OPENTRONS_BUILDROOT_OVERLAYS_PATH/package/python-send2trash/Config.in"
source "$BR2_EXTERNAL_OPENTRONS_BUILDROOT_OVERLAYS_PATH/package/python-sqlalchemy/Config.in"
source "$BR2_EXTERNAL_OPENTRONS_BUILDROOT_OVERLAYS_PATH/package/python-starlette/Config.in"
source "$BR2_EXTERNAL_OPENTRONS_BUILDROOT_OVERLAYS_PATH/package/python-terminado/Config.in"
source "$BR2_EXTERNAL_OPENTRONS_BUILDROOT_OVERLAYS_PATH/package/python-testpath/Config.in"
source "$BR2_EXTERNAL_OPENTRONS_BUILDROOT_OVERLAYS_PATH/package/python-typing-extensions/Config.in"
source "$BR2_EXTERNAL_OPENTRONS_BUILDROOT_OVERLAYS_PATH/package/python-typing-inspection/Config.in"
source "$BR2_EXTERNAL_OPENTRONS_BUILDROOT_OVERLAYS_PATH/package/python-tzdata/Config.in"
source "$BR2_EXTERNAL_OPENTRONS_BUILDROOT_OVERLAYS_PATH/package/python-uvicorn/Config.in"
source "$BR2_EXTERNAL_OPENTRONS_BUILDROOT_OVERLAYS_PATH/package/python-zipp/Config.in"

# Host packages
```

## package/opentrons/Config.in
```kconfig
source "$BR2_EXTERNAL_OPENTRONS_BUILDROOT_OVERLAYS_PATH/package/opentrons/opentrons-smoothie-firmware/Config.in"
source "$BR2_EXTERNAL_OPENTRONS_BUILDROOT_OVERLAYS_PATH/package/opentrons/opentrons-magnetic-module-firmware/Config.in"
source "$BR2_EXTERNAL_OPENTRONS_BUILDROOT_OVERLAYS_PATH/package/opentrons/opentrons-temperature-module-firmware/Config.in"
source "$BR2_EXTERNAL_OPENTRONS_BUILDROOT_OVERLAYS_PATH/package/opentrons/opentrons-thermocycler-firmware/Config.in"
source "$BR2_EXTERNAL_OPENTRONS_BUILDROOT_OVERLAYS_PATH/package/opentrons/opentrons-heater-shaker-firmware/Config.in"
source "$BR2_EXTERNAL_OPENTRONS_BUILDROOT_OVERLAYS_PATH/package/opentrons/opentrons-thermocycler-gen2-firmware/Config.in"
```

## package/python-deprecation/Config.in
```kconfig
config BR2_PACKAGE_PYTHON_DEPRECATION
	bool "python-deprecation"
	select BR2_PACKAGE_PYTHON_PACKAGING # runtime
	help
	  A library to handle automated deprecations.

	  http://deprecation.readthedocs.io/
```

## package/python-expandvars/Config.in
```kconfig
config BR2_PACKAGE_PYTHON_EXPANDVARS
	bool "python-expandvars"
	help
	  Expand system variables Unix style.

	  https://github.com/sayanarijit/expandvars
```

## package/python-jupyter-packaging/Config.in
```kconfig
config BR2_PACKAGE_PYTHON_JUPYTER_PACKAGING
	bool "python-jupyter-packaging"
	help
	  Jupyter Packaging Utilities.

	  http://jupyter.org
```

## package/python-nbclassic/Config.in
```kconfig
config BR2_PACKAGE_PYTHON_NBCLASSIC
    bool "python-nbclassic"
    help
      Jupyter notebook 6.x support for Jupyter server 7.

      https://github.com/jupyter/nbclassic

config BR2_PACKAGE_PYTHON_NBCLASSIC_DEFER_INSTALL
    bool "python-nbclassic.deferinstall"
    help
      Selecting this option installs the nbclassic wheel in
      /usr/share/deferred-py-installs to be installed after boot.
```

## package/python-typing-inspection/Config.in
```kconfig
config BR2_PACKAGE_PYTHON_TYPING_INSPECTION
	bool "python-typing-inspection"
	help
	  Runtime typing introspection tools.

	  https://github.com/pydantic/typing-inspection
```

## package/python-tzdata/Config.in
```kconfig
config BR2_PACKAGE_PYTHON_TZDATA
	bool "python-tzdata"
	help
	  Provider of IANA time zone data.

	  https://github.com/python/tzdata

config BR2_PACKAGE_PYTHON_TZDATA_DEFER_INSTALL
       bool "python-tzdata.deferinstall"
       help
         Selecting this option installs the tzdata wheel in /usr/share/deferred-py-installs to
         be installed after boot.
```
