## package/python-matplotlib-inline/Config.in
```kconfig
config BR2_PACKAGE_PYTHON_MATPLOTLIB_INLINE
	bool "python-matplotlib-inline"
	help
	  Matplotlib to display figures directly inline in the Jupyter notebook

	  https://ipython.org
```

## package/python-meson-python/Config.in.host
```kconfig
config BR2_PACKAGE_HOST_PYTHON_MESON_PYTHON
	bool "host python-meson-python"
	help
	  meson-python is a Python build backend built on top of the Meson build system
	  
	  https://github.com/mesonbuild/meson-python
	  
```

## package/python-meson/Config.in.host
```kconfig
config BR2_HOST_PACKAGE_PYTHON_MESON
	bool "host python-meson"
	help
	  Meson is a cross-platform build system designed to be both as fast and as user friendly as possible. 
	  
	  https://mesonbuild.com/
	  
```

## package/python-multipart/Config.in
```kconfig
config BR2_PACKAGE_PYTHON_MULTIPART
	bool "python-multipart"
	select BR2_PACKAGE_PYTHON_SIX # runtime
	help
	  A streaming multipart parser for Python.

	  http://github.com/andrew-d/python-multipart
```

## package/python-nbconvert/Config.in
```kconfig
config BR2_PACKAGE_PYTHON_NBCONVERT
	bool "python-nbconvert"
	select BR2_PACKAGE_PYTHON_MISTUNE # runtime
	select BR2_PACKAGE_PYTHON_JINJA2 # runtime
	select BR2_PACKAGE_PYTHON_PYGMENTS # runtime
	select BR2_PACKAGE_PYTHON_TRAITLETS # runtime
	select BR2_PACKAGE_PYTHON_JUPYTER_CORE # runtime
	select BR2_PACKAGE_PYTHON_NBFORMAT # runtime
	select BR2_PACKAGE_PYTHON_ENTRYPOINTS # runtime
	select BR2_PACKAGE_PYTHON_BLEACH # runtime
	select BR2_PACKAGE_PYTHON_PANDOCFILTERS # runtime
	select BR2_PACKAGE_PYTHON_TESTPATH # runtime
	select BR2_PACKAGE_PYTHON_DEFUSEDXML # runtime
	help
	  Converting Jupyter Notebooks.

	  https://jupyter.org

config BR2_PACKAGE_PYTHON_NBCONVERT_TESTS
	bool "nbconvert.tests"
	help
		Include test files.
		Selecting this option adds about 0.5 MB to the target file
		system.
```

## package/python-nbformat/Config.in
```kconfig
config BR2_PACKAGE_PYTHON_NBFORMAT
	bool "python-nbformat"
	select BR2_PACKAGE_PYTHON_IPYTHON_GENUTILS # runtime
	select BR2_PACKAGE_PYTHON_TRAITLETS # runtime
	select BR2_PACKAGE_PYTHON_FASTJSONSCHEMA # runtime
	select BR2_PACKAGE_PYTHON_NEST_ASYNCIO # runtime
	select BR2_PACKAGE_PYTHON_JSONSCHEMA # runtime
	select BR2_PACKAGE_PYTHON_JUPYTER_CORE # runtime
	select BR2_PACKAGE_HOST_PYTHON_HATCH_NODEJS_VERSION  # build time for version
	help
	  The Jupyter Notebook format.

	  http://jupyter.org
```

## package/python-nest-asyncio/Config.in
```kconfig
config BR2_PACKAGE_PYTHON_NEST_ASYNCIO
	bool "python-nest-asyncio"
	help
	  Nested eventloop for asyncio

	  https://pypi.org/project/nest-asyncio
```

## package/python-oldest-supported-numpy/Config.in.host
```kconfig
config BR2_PACKAGE_HOST_PYTHON_OLDEST_SUPPORTED_NUMPY
	bool "host python-oldest-supported-numpy"
	help
	  This is a meta-package which can be used in pyproject.toml files to
	  automatically provide as a build-time dependency the oldest version
	  of NumPy that supports the given Python version and platform.
	  
	  https://github.com/scipy/oldest-supported-numpy
	  
```

## package/python-pandas/Config.in
```kconfig
config BR2_PACKAGE_PYTHON_PANDAS
	bool "python-pandas"
	select BR2_PACKAGE_PYTHON_DATEUTIL # runtime
	select BR2_PACKAGE_PYTHON_PYTZ # runtime
	select BR2_PACKAGE_PYTHON_NUMPY # runtime
	select BR2_PACKAGE_PYTHON_TZDATA # runtime
	select BR2_PACKAGE_PYTHON3_BZIP2 # runtime
	select BR2_PACKAGE_HOST_PYTHON_MESON # build time for headers
	select BR2_PACKAGE_HOST_PYTHON_PYPROJECT_METADATA # build time for headers
	select BR2_PACKAGE_HOST_PYTHON_WHEEL # build time for headers
	select BR2_PACKAGE_HOST_PYTHON_VERSIONEER # build time for headers
	select BR2_PACKAGE_HOST_PYTHON_OLDESET_SUPPORTED_NUMPY # build time for headers
	select BR2_PACKAGE_HOST_PYTHON_NUMPY # build time for headers
	select BR2_PACKAGE_HOST_PYTHON_CYTHON  # build time for cython compilation
	help
	  Powerful data structures for data analysis, time series,
	  and statistics.

	  http://pandas.pydata.org

config BR2_PACKAGE_PYTHON_PANDAS_TESTS
	bool "pandas.tests"
	help
		Include test files.
		Selecting this option adds about 7.0 MB to the target file
		system.
```

## package/python-pandocfilters/Config.in
```kconfig
config BR2_PACKAGE_PYTHON_PANDOCFILTERS
	bool "python-pandocfilters"
	help
	  Utilities for writing pandoc filters in python.

	  http://github.com/jgm/pandocfilters
```

## package/python-pastel/Config.in
```kconfig
config BR2_PACKAGE_PYTHON_PASTEL
	bool "python-pastel"
	help
	  Bring colors to your terminal.

	  https://github.com/sdispater/pastel
```

## package/python-pkginfo/Config.in
```kconfig
config BR2_PACKAGE_PYTHON_PKGINFO
	bool "python-pkginfo"
	help
	  Query metadatdata from sdists / bdists / installed
	  packages.

	  https://code.launchpad.net/~tseaver/pkginfo/trunk
```

## package/python-platformdirs/Config.in
```kconfig
config BR2_PACKAGE_PYTHON_PLATFORMDIRS
	bool "python-platformdirs"
	help
	  A small Python module for determining appropriate platform-
	  specific dirs, e.g. a "user data dir".

	  https://github.com/platformdirs/platformdirs
```

## package/python-poetry-core/Config.in
```kconfig
config BR2_PACKAGE_PYTHON_POETRY_CORE
	bool "python-poetry-core"
	help
	  Poetry PEP 517 Build Backend.

	  https://github.com/python-poetry/poetry-core
```

## package/python-poetry/Config.in
```kconfig
config BR2_PACKAGE_PYTHON_POETRY
	bool "python-poetry"
	select BR2_PACKAGE_PYTHON_CACHECONTROL # runtime
	select BR2_PACKAGE_PYTHON_CACHY # runtime
	select BR2_PACKAGE_PYTHON_CLEO # runtime
	select BR2_PACKAGE_PYTHON_CLIKIT # runtime
	select BR2_PACKAGE_PYTHON_HTML5LIB # runtime
	select BR2_PACKAGE_PYTHON_PACKAGING # runtime
	select BR2_PACKAGE_PYTHON_PEXPECT # runtime
	select BR2_PACKAGE_PYTHON_PKGINFO # runtime
	select BR2_PACKAGE_PYTHON_POETRY_CORE # runtime
	select BR2_PACKAGE_PYTHON_REQUESTS_TOOLBELT # runtime
	select BR2_PACKAGE_PYTHON_REQUESTS # runtime
	select BR2_PACKAGE_PYTHON_SHELLINGHAM # runtime
	select BR2_PACKAGE_PYTHON_TOMLKIT # runtime
	select BR2_PACKAGE_PYTHON_VIRTUALENV # runtime
	help
	  Python dependency management and packaging made easy.

	  https://python-poetry.org/
```

## package/python-prometheus_client/Config.in
```kconfig
config BR2_PACKAGE_PYTHON_PROMETHEUS_CLIENT
	bool "python-prometheus_client"
	help
	  Python client for the Prometheus monitoring system.

	  https://github.com/prometheus/client_python
```

## package/python-pyjwt/Config.in
```kconfig
config BR2_PACKAGE_PYTHON_PYJWT
	bool "python-pyjwt"
	help
	  python-pyjwt is a Python library to encode and decode JSON Web Tokens.

	  https://github.com/jpadilla/pyjwt
```

## package/python-pylev/Config.in
```kconfig
config BR2_PACKAGE_PYTHON_PYLEV
	bool "python-pylev"
	help
	  A pure Python Levenshtein implementation that's not
	  freaking GPL'd.

	  http://github.com/toastdriven/pylev
```

## package/python-pyproject-metadata/Config.in.host
```kconfig
config BR2_PACKAGE_HOST_PYTHON_PYPROJECT_METADATA
	bool "host python-pyproject-metadata"
	help
	  This project does not implement the parsing of pyproject.toml containing PEP 621 metadata.
	  Instead, given a Python data structure representing PEP 621 metadata (already parsed), 
	  it will validate this input and generate a PEP 643-compliant metadata file (e.g. PKG-INFO). 
	  
	  https://github.com/FFY00/python-pyproject-metadata
	  
```

## package/python-pyrsistent/Config.in
```kconfig
config BR2_PACKAGE_PYTHON_PYRSISTENT
	bool "python-pyrsistent"
	select BR2_PACKAGE_PYTHON_SIX # runtime
	help
	  Persistent/Functional/Immutable data structures.

	  http://github.com/tobgu/pyrsistent/
```

## package/python-python-version/Config.in.host
```kconfig
config BR2_HOST_PACKAGE_PYTHON_PYTHON_VERSION
	bool "host python-python_version"
	help
	  This package provides a basic python version checking utility.
	  
	  https://gitlab.com/halfak/python_version
	  
```

## package/python-pyzmq/Config.in
```kconfig
config BR2_PACKAGE_PYTHON_PYZMQ
	bool "python-pyzmq"
	help
	  Python bindings for 0MQ.

	  https://pyzmq.readthedocs.org
```

## package/python-send2trash/Config.in
```kconfig
config BR2_PACKAGE_PYTHON_SEND2TRASH
	bool "python-send2trash"
	help
	  Send file to trash natively under Mac OS X, Windows and
	  Linux.

	  https://github.com/hsoft/send2trash
```

## package/python-shellingham/Config.in
```kconfig
config BR2_PACKAGE_PYTHON_SHELLINGHAM
	bool "python-shellingham"
	help
	  Tool to Detect Surrounding Shell.

	  https://github.com/sarugaku/shellingham
```

## package/python-sniffio/Config.in
```kconfig
config BR2_PACKAGE_PYTHON_SNIFFIO
	bool "python-sniffio"
	depends on BR2_PACKAGE_PYTHON3
	help
	  Sniff out which async library your code is running under.

	  https://github.com/python-trio/sniffio
```
