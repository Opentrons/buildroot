## package/python-clikit/Config.in
```kconfig
config BR2_PACKAGE_PYTHON_CLIKIT
	bool "python-clikit"
	select BR2_PACKAGE_PYTHON_PASTEL # runtime
	select BR2_PACKAGE_PYTHON_PYLEV # runtime
	help
	  CliKit is a group of utilities to build beautiful and
	  testable command line interfaces.

	  https://github.com/sdispater/clikit
```

## package/python-comm/Config.in
```kconfig
config BR2_PACKAGE_PYTHON_COMM
	bool "python-comm"
	help
	  It provides a way to register a Kernel Comm implementation, 
	  as per the Jupyter kernel protocol. 
	  It also provides a base Comm implementation and a default 
	  CommManager that can be used.

	  https://github.com/ipython/comm
```

## package/python-debugpy/Config.in
```kconfig
config BR2_PACKAGE_PYTHON_DEBUGPY
	bool "python-debugpy"
	help
	  debugpy is an implementation of the Debug Adapter Protocol for Python.

	  https://aka.ms/debugpy
```

## package/python-defusedxml/Config.in
```kconfig
config BR2_PACKAGE_PYTHON_DEFUSEDXML
	bool "python-defusedxml"
	help
	  XML bomb protection for Python stdlib modules.

	  https://github.com/tiran/defusedxml
```

## package/python-distlib/Config.in
```kconfig
config BR2_PACKAGE_PYTHON_DISTLIB
	bool "python-distlib"
	help
	  Distribution utilities.

	  https://bitbucket.org/pypa/distlib
```

## package/python-dotenv/Config.in
```kconfig
config BR2_PACKAGE_PYTHON_DOTENV
	bool "python-dotenv"
	select BR2_PACKAGE_PYTHON_TYPING # runtime
	help
	  Add .env support to your django/flask apps in development
	  and deployments.

	  http://github.com/theskumar/python-dotenv
```

## package/python-evdev/Config.in
```kconfig
config BR2_PACKAGE_PYTHON_EVDEV
	bool "python-evdev"
	select BR_PACKAGE_LIBEVDEV
	help
	  Bindings to the Linux input handling subsystem.

	  https://github.com/gvalkov/python-evdev
```

## package/python-exceptiongroup/Config.in
```kconfig
config BR2_PACKAGE_PYTHON_EXCEPTIONGROUP
	bool "python-exceptiongroup"
	help
	  This is a backport of the BaseExceptionGroup and ExceptionGroup classes from Python 3.11.

	  https://github.com/agronholm/exceptiongroup
```

## package/python-fastapi/Config.in
```kconfig
config BR2_PACKAGE_PYTHON_FASTAPI
	bool "python-fastapi"
	depends on BR2_PACKAGE_PYTHON3	
	select BR2_PACKAGE_PYTHON_STARLETTE # runtime
	select BR2_PACKAGE_PYTHON_PYDANTIC # runtime
	help
	  FastAPI framework, high performance, easy to learn, fast to
	  code, ready for production.

	  https://github.com/tiangolo/fastapi
```

## package/python-fastjsonschema/Config.in
```kconfig
config BR2_PACKAGE_PYTHON_FASTJSONSCHEMA
	bool "python-fastjsonschema"
	help
	  An implementation of fast JSON Schema validation for Python.

	  https://github.com/horejsek/python-fastjsonschema/
```

## package/python-filetype/Config.in
```kconfig
config BR2_PACKAGE_PYTHON_FILETYPE
	bool "python-filetype"
	help
	  Small and dependency free Python package to infer file type.

	  https://github.com/h2non/filetype.py
```

## package/python-funcsigs/Config.in
```kconfig
config BR2_PACKAGE_PYTHON_FUNCSIGS
	bool "python-funcsigs"
	help
	  Python function signatures from PEP362 for Python 2.6, 2.7
	  and 3.2+.

	  http://funcsigs.readthedocs.org
```

## package/python-hatch-nodejs-version/Config.in.host
```kconfig
config BR2_PACKAGE_HOST_PYTHON_HATCH_NODEJS_VERSION
	bool "host python-hatch-nodejs-version"
	help
	  Version source plugin that reads/writes the package version from the version field of the Node.js

	  https://github.com/agoose77/hatch-nodejs-version
```

## package/python-hatchling/Config.in.host
```kconfig
config BR2_PACKAGE_HOST_PYTHON_HATCHLING
	bool "host python-hatchling"
	help
	  This is the extensible, standards compliant build backend used by Hatch.

	  https://hatch.pypa.io/latest/
```

## package/python-httptools/Config.in
```kconfig
config BR2_PACKAGE_PYTHON_HTTPTOOLS
	bool "python-httptools"
	depends on BR2_PACKAGE_PYTHON3
    depends on BR2_PACKAGE_HOST_PYTHON_CYTHON
	help
	  A collection of framework independent HTTP protocol utils.

	  https://github.com/MagicStack/httptools
```

## package/python-idna/Config.in
```kconfig
config BR2_PACKAGE_PYTHON_IDNA
	bool "python-idna"
	depends on BR2_PACKAGE_PYTHON3
	help
	  Internationalized Domain Names in Applications (IDNA).

	  https://github.com/kjd/idna
```

## package/python-importlib-metadata/Config.in
```kconfig
config BR2_PACKAGE_PYTHON_IMPORTLIB_METADATA
	bool "python-importlib-metadata"
	depends on BR2_PACKAGE_PYTHON3
	select BR2_PACKAGE_PYTHON_ZIPP # runtime
	select BR2_PACKAGE_PYTHON_TYPING_EXTENSIONS # runtime
	help
	  Read metadata from Python packages.

	  https://github.com/python/importlib_metadata
```

## package/python-importlib-resources/Config.in
```kconfig
config BR2_PACKAGE_PYTHON_IMPORTLIB_RESOURCES
	bool "python-importlib-resources"
	depends on BR2_PACKAGE_PYTHON3
	select BR2_PACKAGE_PYTHON_ZIPP # runtime
	help
	  Read resources from Python packages.

	  https://github.com/python/importlib_resources
```

## package/python-ipykernel/Config.in
```kconfig
config BR2_PACKAGE_PYTHON_IPYKERNEL
	bool "python-ipykernel"
	select BR2_PACKAGE_PYTHON_IPYTHON # runtime
	select BR2_PACKAGE_PYTHON_TRAITLETS # runtime
	select BR2_PACKAGE_PYTHON_JUPYTER_CLIENT # runtime
	select BR2_PACKAGE_PYTHON_PACKAGING # runtime
	select BR2_PACKAGE_PYTHON_PSUTIL # runtime
	select BR2_PACKAGE_PYTHON_MATPLOTLIB_INLINE # runtime
	select BR2_PACKAGE_PYTHON_TORNADO # runtime
    select BR2_PACKAGE_PYTHON3_SQLITE # runtime
	help
	  IPython Kernel for Jupyter.

	  https://ipython.org
```

## package/python-ipython/Config.in
```kconfig
config BR2_PACKAGE_PYTHON_IPYTHON
	bool "python-ipython"
	select BR2_PACKAGE_PYTHON_BACKCALL # runtime
	select BR2_PACKAGE_PYTHON_DECORATOR # runtime
	select BR2_PACKAGE_PYTHON_JEDI # runtime
	select BR2_PACKAGE_PYTHON_PICKLESHARE # runtime
	select BR2_PACKAGE_PYTHON_PROMPT_TOOLKIT # runtime
	select BR2_PACKAGE_PYTHON_PYGMENTS  # runtime
	select BR2_PACKAGE_PYTHON_PEXPECT # runtime
	select BR2_PACKAGE_PYTHON_TRAITLETS  # runtime
	select BR2_PACKAGE_PYTHON_SIMPLEGENERIC
	help
	  IPython is a command shell for interactive computing in
	  multiple programming languages, originally developed for the
	  Python programming language, that offers enhanced
	  introspection, rich media, additional shell syntax, tab
	  completion, and rich history.

	  http://ipython.org/

config BR2_PACKAGE_PYTHON_IPYTHON_TESTS
	bool "ipython.tests"
	help
		Include test files.
		Selecting this option adds about 0.7 MB to the target file
		system.
```

## package/python-jsonrpcclient/Config.in
```kconfig
config BR2_PACKAGE_PYTHON_JSONRPCCLIENT
	bool "python-jsonrpcclient"
	select BR2_PACKAGE_PYTHON_APPLY_DEFAULTS # runtime
	select BR2_PACKAGE_PYTHON_CLICK # runtime
	select BR2_PACKAGE_PYTHON_JSONSCHEMA # runtime
	help
	  Send JSON-RPC requests.

	  https://github.com/bcb/jsonrpcclient
```

## package/python-jsonrpcserver/Config.in
```kconfig
config BR2_PACKAGE_PYTHON_JSONRPCSERVER
	bool "python-jsonrpcserver"
	select BR2_PACKAGE_PYTHON_APPLY_DEFAULTS # runtime
	select BR2_PACKAGE_PYTHON_JSONSCHEMA # runtime
	select BR2_PACKAGE_PYTHON_FUNCSIGS # runtime
	help
	  Process JSON-RPC requests.

	  https://github.com/bcb/jsonrpcserver
```

## package/python-jsonschema/Config.in
```kconfig
config BR2_PACKAGE_PYTHON_JSONSCHEMA
	bool "python-jsonschema"
	help
	  An implementation of JSON Schema validation for Python.

	  http://github.com/Julian/jsonschema

config BR2_PACKAGE_PYTHON_JSONSCHEMA_TESTS
	bool "jsonschema.tests"
	help
		Include test files.
		Selecting this option adds about 0.5 MB to the target file
		system.
```

## package/python-jupyter_client/Config.in
```kconfig
config BR2_PACKAGE_PYTHON_JUPYTER_CLIENT
	bool "python-jupyter_client"
	select BR2_PACKAGE_PYTHON_TRAITLETS # runtime
	select BR2_PACKAGE_PYTHON_JUPYTER_CORE # runtime
	select BR2_PACKAGE_PYTHON_PYZMQ # runtime
	select BR2_PACKAGE_PYTHON_DATEUTIL # runtime
	select BR2_PACKAGE_PYTHON_TORNADO # runtime
	help
	  Jupyter protocol implementation and client libraries.

	  https://jupyter.org
```

## package/python-jupyter_core/Config.in
```kconfig
config BR2_PACKAGE_PYTHON_JUPYTER_CORE
	bool "python-jupyter_core"
	select BR2_PACKAGE_PYTHON_TRAITLETS # runtime
	help
	  Jupyter core package. A base package on which Jupyter
	  projects rely.

	  https://jupyter.org

config BR2_PACKAGE_PYTHON_JUPYTER_CORE_TESTS
	bool "jupyter_core.tests"
	help
		Include test files.
		Selecting this option adds about 0.5 MB to the target file
		system.
```
