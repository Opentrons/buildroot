## package/python-sqlalchemy/Config.in
```kconfig
config BR2_PACKAGE_PYTHON_SQLALCHEMY
	bool "python-sqlalchemy"

	select BR2_PACKAGE_PYTHON_IMPORTLIB_METADATA # runtime
	select BR2_PACKAGE_PYTHON_GREENLET # runtime
	select BR2_PACKAGE_PYTHON_TYPING_EXTENSIONS # runtime

	help
	  SQLAlchemy is the Python SQL toolkit and Object Relational
	  Mapper that gives application developers the full power and
	  flexibility of SQL.

	  It provides a full suite of well known enterprise-level
	  persistence patterns, designed for efficient and
	  high-performing database access, adapted into a simple and
	  Pythonic domain language.

	  http://www.sqlalchemy.org

config BR2_PACKAGE_PYTHON_SQLALCHEMY_TESTS
	bool "sqlalchemy.tests"
	help
		Include test files.
		Selecting this option adds about 0.5 MB to the target file
		system.
```

## package/python-starlette/Config.in
```kconfig
config BR2_PACKAGE_PYTHON_STARLETTE
	bool "python-starlette"
	depends on BR2_PACKAGE_PYTHON3	
	help
	  The little ASGI library that shines.

	  https://github.com/encode/starlette
```

## package/python-terminado/Config.in
```kconfig
config BR2_PACKAGE_PYTHON_TERMINADO
	bool "python-terminado"
	select BR2_PACKAGE_PYTHON_TORNADO # runtime
	help
	  Terminals served to xterm.js using Tornado websockets.

	  https://github.com/jupyter/terminado
```

## package/python-testpath/Config.in
```kconfig
config BR2_PACKAGE_PYTHON_TESTPATH
	bool "python-testpath"
	help
	  Test utilities for code working with files and commands.

	  https://github.com/jupyter/testpath
```

## package/python-tornado/Config.in
```kconfig
config BR2_PACKAGE_PYTHON_TORNADO
	bool "python-tornado"
	select BR2_PACKAGE_PYTHON3_ZLIB
	select BR2_PACKAGE_PYTHON3_SSL
	help
	  Tornado is a Python web framework and asynchronous networking
	  library, originally developed at FriendFeed.

	  http://www.tornadoweb.org

config BR2_PACKAGE_PYTHON_TORNADO_TESTS
	bool "tornado.tests"
	help
		Include test files.
		Selecting this option adds about 0.5 MB to the target file
		system.
```

## package/python-traitlets/Config.in
```kconfig
config BR2_PACKAGE_PYTHON_TRAITLETS
	bool "python-traitlets"
	help
	  A configuration system for Python applications.

	  https://pypi.python.org/pypi/traitlets

config BR2_PACKAGE_PYTHON_TRAITLETS_TESTS
	bool "traitlets.tests"
	help
		Include test files.
		Selecting this option adds about 0.5 MB to the target file
		system.
```

## package/python-uvicorn/Config.in
```kconfig
config BR2_PACKAGE_PYTHON_UVICORN
	bool "python-uvicorn"
	depends on BR2_PACKAGE_PYTHON3
	select BR2_PACKAGE_PYTHON_CLICK # runtime
	select BR2_PACKAGE_PYTHON_H11 # runtime
	select BR2_PACKAGE_PYTHON_WEBSOCKETS # runtime
	select BR2_PACKAGE_PYTHON_HTTPTOOLS # runtime
	select BR2_PACKAGE_PYTHON_UVLOOP # runtime
	help
	  The lightning-fast ASGI server.

	  https://github.com/encode/uvicorn
```

## package/python-versioneer/Config.in.host
```kconfig
config BR2_HOST_PACKAGE_PYTHON_VERSIONEER
	bool "host python-versioneer"
	help
	  Versioneer is a tool to automatically update version strings (in setup.py and the conventional ‘from PROJECT import _version’ pattern) by asking your version-control system about the current tree.
	  
	  https://github.com/warner/python-versioneer
	  
```

## package/python-virtualenv/Config.in
```kconfig
config BR2_PACKAGE_PYTHON_VIRTUALENV
	bool "python-virtualenv"
	select BR2_PACKAGE_PYTHON_BACKPORTSENTRY_POINTS_SELECTABLE # runtime
	select BR2_PACKAGE_PYTHON_DISTLIB # runtime
	select BR2_PACKAGE_PYTHON_FILELOCK # runtime
	select BR2_PACKAGE_PYTHON_PLATFORMDIRS # runtime
	select BR2_PACKAGE_PYTHON_SIX # runtime
	select BR2_PACKAGE_PYTHON_IMPORTLIB_METADATA # runtime
	select BR2_PACKAGE_PYTHON_IMPORTLIB_RESOURCES # runtime
	select BR2_PACKAGE_PYTHON_PATHLIB2 # runtime
	help
	  Virtual Python Environment builder.

	  https://virtualenv.pypa.io/
```

## package/python-wheel/Config.in.host
```kconfig
config BR2_HOST_PACKAGE_PYTHON_WHEEL
	bool "host python-wheel"
	help
	  Meson is a cross-platform build system designed to be both as fast and as user friendly as possible. 
	  
	 https://github.com/pypa/wheel
	  
```

## package/python-yarl/Config.in
```kconfig
config BR2_PACKAGE_PYTHON_YARL
	bool "python-yarl"
	select BR2_PACKAGE_PYTHON_MULTIDICT
	select BR2_PACKAGE_PYTHON_IDNA
	help
	  Yet another URL library.

	  http://yarl.readthedocs.io/

config BR2_PACKAGE_PYTHON_YARL_SOURCE
        bool "yarl.source"
        help
                Include source files (.c, .pyx, .pxd).
                Selecting this option adds about 1 MB to the target file
                system.
```

## package/python-zipp/Config.in
```kconfig
config BR2_PACKAGE_PYTHON_ZIPP
	bool "python-zipp"
	depends on BR2_PACKAGE_PYTHON3
	help
	  Backport of pathlib-compatible object wrapper for zip files.

	  https://github.com/jaraco/zipp
```
