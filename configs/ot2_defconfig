## configs/ot2_defconfig
```kconfig
BR2_arm=y
BR2_cortex_a53=y
BR2_ARM_FPU_NEON_VFPV4=y

BR2_TOOLCHAIN_BUILDROOT_CXX=y
BR2_TOOLCHAIN_EXTERNAL=y
BR2_TOOLCHAIN_EXTERNAL_LINARO_ARM=y
BR2_GLOBAL_PATCH_DIR="board/opentrons/ot2/package-patches"

BR2_SYSTEM_DHCP="eth0"

# Linux headers same as kernel, a 5.10 series
BR2_PACKAGE_HOST_LINUX_HEADERS_CUSTOM_5_10=y

BR2_LINUX_KERNEL=y
BR2_LINUX_KERNEL_CUSTOM_TARBALL=y
BR2_LINUX_KERNEL_CUSTOM_TARBALL_LOCATION="$(call github,raspberrypi,linux,0b54dbda3cca2beb51e236a25738784e90853b64)/linux-0b54dbda3cca2beb51e236a25738784e90853b64.tar.gz"
BR2_LINUX_KERNEL_PATCH="board/opentrons/ot2/kernel-patches"
BR2_LINUX_KERNEL_DEFCONFIG="bcm2709"
BR2_LINUX_KERNEL_CONFIG_FRAGMENT_FILES="board/opentrons/ot2/bcm2907-frag.config"

# Build the DTB from the kernel sources
BR2_LINUX_KERNEL_DTS_SUPPORT=y
BR2_LINUX_KERNEL_INTREE_DTS_NAME="bcm2710-rpi-3-b bcm2710-rpi-3-b-plus bcm2710-rpi-cm3"
BR2_LINUX_KERNEL_NEEDS_HOST_OPENSSL=y
BR2_LINUX_KERNEL_INSTALL_TARGET=y

# Filesystem / image
BR2_INIT_SYSTEMD=y
BR2_GENERATE_LOCALE="en_US.UTF-8"
BR2_TARGET_GENERIC_HOSTNAME="opentrons"
BR2_TARGET_GENERIC_ISSUE="Welcome to the Opentrons OT2"

BR2_TARGET_ROOTFS_EXT2=y
BR2_TARGET_ROOTFS_EXT2_4=y
BR2_TARGET_ROOTFS_EXT2_SIZE="512M"
BR2_TARGET_ROOTFS_TAR_GZIP=y
BR2_TARGET_UBOOT=y
BR2_TARGET_UBOOT_BOARD_DEFCONFIG="rpi_3_32b"

BR2_ROOTFS_POST_BUILD_SCRIPT="board/opentrons/ot2/post-build.sh"
BR2_ROOTFS_POST_FAKEROOT_SCRIPT="board/opentrons/ot2/in-fakeroot.sh"
BR2_ROOTFS_POST_IMAGE_SCRIPT="board/opentrons/ot2/post-image.sh"
BR2_ROOTFS_OVERLAY="board/opentrons/ot2/rootfs-overlay"

# Host Packages
BR2_PACKAGE_HOST_DOSFSTOOLS=y
BR2_PACKAGE_HOST_GENEXT2FS=y
BR2_PACKAGE_HOST_GENIMAGE=y
BR2_PACKAGE_HOST_MTOOLS=y
BR2_PACKAGE_HOST_UBOOT_TOOLS=y
BR2_PACKAGE_HOST_UBOOT_TOOLS_BOOT_SCRIPT=y
BR2_PACKAGE_HOST_UBOOT_TOOLS_BOOT_SCRIPT_SOURCE="board/opentrons/ot2/boot.scr"
BR2_PACKAGE_HOST_ZIP=y

# Target Packages
BR2_PACKAGE_RPI_FIRMWARE=y
BR2_PACKAGE_RPI_FIRMWARE_BOOTCODE_BIN=y
BR2_PACKAGE_RPI_FIRMWARE_VARIANT_PI=y
BR2_PACKAGE_RPI_FIRMWARE_CONFIG_FILE="board/opentrons/ot2/config.txt"
BR2_PACKAGE_BRCMFMAC_SDIO_FIRMWARE_RPI=y
BR2_PACKAGE_BRCMFMAC_SDIO_FIRMWARE_RPI_WIFI=y
BR2_PACKAGE_UBOOT_TOOLS=y

BR2_PACKAGE_FFMPEG=y
BR2_PACKAGE_FFMPEG_GPL=y
BR2_PACKAGE_FFMPEG_NONFREE=y
BR2_PACKAGE_FFMPEG_SWSCALE=y
BR2_PACKAGE_MPG123=y
BR2_PACKAGE_GIT=y
BR2_PACKAGE_GREP=y
BR2_PACKAGE_E2FSPROGS=y
BR2_PACKAGE_E2FSPROGS_RESIZE2FS=y
BR2_PACKAGE_AVRDUDE=y
BR2_PACKAGE_BOSSA=y
BR2_PACKAGE_DFU_UTIL=y
BR2_PACKAGE_DBUS_PYTHON=y
BR2_PACKAGE_I2C_TOOLS=y
BR2_PACKAGE_RPI_USERLAND=y
BR2_PACKAGE_USBMOUNT=y
BR2_PACKAGE_ALSA_LIB=y
BR2_PACKAGE_CA_CERTIFICATES=y
BR2_PACKAGE_LIBRESSL=y
BR2_PACKAGE_LIBRESSL_BIN=y
BR2_PACKAGE_DTC=y
BR2_PACKAGE_DTC_PROGRAMS=y
BR2_PACKAGE_LIBGPIOD=y
BR2_PACKAGE_LIBCURL=y
BR2_PACKAGE_LIBCURL_CURL=y
BR2_PACKAGE_AVAHI=y
BR2_PACKAGE_AVAHI_DAEMON=y
BR2_PACKAGE_CRDA=y
BR2_PACKAGE_DHCP=y
BR2_PACKAGE_DHCP_CLIENT=y
BR2_PACKAGE_DROPBEAR=y
BR2_PACKAGE_IW=y
BR2_PACKAGE_NETWORK_MANAGER=y
BR2_PACKAGE_NGINX=y
BR2_PACKAGE_NGINX_HTTP_MAP_MODULE=y
BR2_PACKAGE_WGET=y
BR2_PACKAGE_WPA_SUPPLICANT=y
BR2_PACKAGE_WPA_SUPPLICANT_AUTOSCAN=y
BR2_PACKAGE_WPA_SUPPLICANT_EAP=y
BR2_PACKAGE_WPA_SUPPLICANT_DEBUG_SYSLOG=y
BR2_PACKAGE_WPA_SUPPLICANT_CLI=y
BR2_PACKAGE_WPA_SUPPLICANT_WPA_CLIENT_SO=y
BR2_PACKAGE_WPA_SUPPLICANT_PASSPHRASE=y
BR2_PACKAGE_WPA_SUPPLICANT_DBUS=y
BR2_PACKAGE_WPA_SUPPLICANT_DBUS_INTROSPECTION=y
BR2_PACKAGE_FILE=y
BR2_PACKAGE_SCREEN=y
BR2_PACKAGE_TMUX=y
BR2_PACKAGE_WHICH=y
BR2_PACKAGE_SYSLOG_NG=y
BR2_PACKAGE_BUSYBOX_CONFIG_FRAGMENT_FILES="board/opentrons/ot2/busybox-add-compress-to-tar.cfg"

# Python Packages
BR2_PACKAGE_PYTHON3=y
BR2_PACKAGE_PYTHON3_BZIP2=y
BR2_PACKAGE_PYTHON3_CURSES=y
BR2_PACKAGE_PYTHON3_DECIMAL=y
BR2_PACKAGE_PYTHON3_READLINE=y
BR2_PACKAGE_PYTHON3_SQLITE=y
BR2_PACKAGE_PYTHON3_XZ=y
BR2_PACKAGE_PYTHON_AIONOTIFY=y
BR2_PACKAGE_PYTHON_NOTEBOOK=y
BR2_PACKAGE_PYTHON_PANDAS=y
BR2_PACKAGE_PYTHON_PIP=y
BR2_PACKAGE_PYTHON_PYRSISTENT=y
BR2_PACKAGE_PYTHON_SYSTEMD=y

# Opentrons Packages
BR2_PACKAGE_OPENTRONS_SMOOTHIE_FIRMWARE=y
BR2_PACKAGE_OPENTRONS_MAGNETIC_MODULE_FIRMWARE=y
BR2_PACKAGE_OPENTRONS_TEMPERATURE_MODULE_FIRMWARE=y
BR2_PACKAGE_OPENTRONS_THERMOCYCLER_FIRMWARE=y
BR2_PACKAGE_OPENTRONS_HEATER_SHAKER_FIRMWARE=y

BR2_PACKAGE_PYTHON_OPENTRONS_API=y
BR2_PACKAGE_PYTHON_OPENTRONS_UPDATE_SERVER=y
BR2_PACKAGE_PYTHON_OPENTRONS_ROBOT_SERVER=y
BR2_PACKAGE_PYTHON_OPENTRONS_SHARED_DATA=y
BR2_PACKAGE_PYTHON_OPENTRONS_NOTIFY_SERVER=y
```

## configs/ot2_kernelramfs_defconfig
```kconfig
BR2_arm=y
BR2_cortex_a53=y
BR2_ARM_FPU_NEON_VFPV4=y
 
BR2_TOOLCHAIN_BUILDROOT_CXX=y
BR2_TOOLCHAIN_EXTERNAL=y
BR2_TOOLCHAIN_EXTERNAL_LINARO_ARM=y
BR2_PACKAGE_HOST_ENVIRONMENT_SETUP=y

# Linux headers same as kernel, a 4.14 series
BR2_PACKAGE_HOST_LINUX_HEADERS_CUSTOM_4_14=y
 
BR2_LINUX_KERNEL=y
BR2_LINUX_KERNEL_CUSTOM_TARBALL=y
BR2_LINUX_KERNEL_CUSTOM_TARBALL_LOCATION="$(call github,raspberrypi,linux,6d27aa156c26977dfd079a7107e31670127d17d3)/linux-6d27aa156c26977dfd079a7107e31670127d17d3.tar.gz"
BR2_LINUX_KERNEL_DEFCONFIG="bcm2709"
BR2_LINUX_KERNEL_CONFIG_FRAGMENT_FILES="board/opentrons/ot2/kernelRamfs/kernelRamfs-frag.config"
BR2_LINUX_KERNEL_DTS_SUPPORT=y
BR2_LINUX_KERNEL_INTREE_DTS_NAME="bcm2710-rpi-3-b-plus"

BR2_ROOTFS_POST_IMAGE_SCRIPT="board/opentrons/ot2/kernelRamfs/post-image.sh"
BR2_ROOTFS_OVERLAY="board/opentrons/ot2/kernelRamfs/rootfs-overlay"

# INITRAMFS
BR2_TARGET_ROOTFS_INITRAMFS=y
BR2_TARGET_ROOTFS_CPIO=y
BR2_TARGET_ROOTFS_CPIO_XZ=y
BR2_TARGET_ROOTFS_TAR=n

# Target Packages
BR2_PACKAGE_UBOOT_TOOLS=y
BR2_PACKAGE_UBOOT_TOOLS_FWPRINTENV=y
BR2_PACKAGE_BUSYBOX_CONFIG_FRAGMENT_FILES="board/opentrons/ot2/kernelRamfs/busybox-frag.config"
```

## configs/ot2_tiny_defconfig
```kconfig
BR2_arm=y
BR2_cortex_a53=y
BR2_ARM_FPU_NEON_VFPV4=y
 
BR2_TOOLCHAIN_BUILDROOT_CXX=y
BR2_TOOLCHAIN_EXTERNAL=y
BR2_TOOLCHAIN_EXTERNAL_LINARO_ARM=y
BR2_PACKAGE_HOST_ENVIRONMENT_SETUP=y
#BR2_SYSTEM_DHCP="eth0"

# Linux headers same as kernel, a 4.14 series
BR2_PACKAGE_HOST_LINUX_HEADERS_CUSTOM_4_14=y
 
BR2_LINUX_KERNEL=y
BR2_LINUX_KERNEL_CUSTOM_TARBALL=y
BR2_LINUX_KERNEL_CUSTOM_TARBALL_LOCATION="$(call github,raspberrypi,linux,6d27aa156c26977dfd079a7107e31670127d17d3)/linux-6d27aa156c26977dfd079a7107e31670127d17d3.tar.gz"
BR2_LINUX_KERNEL_DEFCONFIG="bcm2709"
BR2_LINUX_KERNEL_CONFIG_FRAGMENT_FILES="board/opentrons/ot2/tiny-kernel/tiny_kernel-frag.config"

BR2_ROOTFS_POST_BUILD_SCRIPT="board/opentrons/ot2/tiny-kernel/post-build.sh"
BR2_ROOTFS_POST_FAKEROOT_SCRIPT="board/opentrons/ot2/tiny-kernel/in-fakeroot.sh"
BR2_ROOTFS_POST_IMAGE_SCRIPT="board/opentrons/ot2/tiny-kernel/post-image.sh"
BR2_ROOTFS_OVERLAY="board/opentrons/ot2/tiny-kernel/rootfs-overlay"

# Host Packages
#BR2_PACKAGE_HOST_DOSFSTOOLS=y
#BR2_PACKAGE_HOST_GENEXT2FS=y
#BR2_PACKAGE_HOST_GENIMAGE=y
#BR2_PACKAGE_HOST_MTOOLS=y

# INITRAMFS
BR2_TARGET_ROOTFS_INITRAMFS=y
BR2_TARGET_ROOTFS_CPIO=y
BR2_TARGET_ROOTFS_CPIO_GZIP=y
BR2_TARGET_ROOTFS_TAR=n
```

## package/bossa/Config.in
```kconfig
config BR2_PACKAGE_BOSSA
	bool "bossa"
	depends on BR2_INSTALL_LIBSTDCPP # c++
	help
	  BOSSA is a flash programming utility for the Atmel SAM family of flash-based
	  ARM microcontrollers.

	  https://github.com/shumatech/BOSSA
```

## package/opentrons-smoothie-firmware/Config.in
```kconfig
config BR2_PACKAGE_OPENTRONS_SMOOTHIE_FIRMWARE
	bool "opentrons-smoothie-firmware"
	help
		Opentrons Smoothie Firmware

		Pre-combined binaries of the current smoothie board
		firmware for an Opentrons OT-2

		https://github.com/opentrons/smoothiewareot
```

## package/opentrons/opentrons-heater-shaker-firmware/Config.in
```kconfig
config BR2_PACKAGE_OPENTRONS_HEATER_SHAKER_FIRMWARE
	bool "opentrons-heater-shaker-firmware"
	help
		Opentrons Heater-Shaker Firmware

		Binary of the current board firmware
		for an Opentrons Heater-Shaker

		https://github.com/opentrons/opentrons-modules
```

## package/opentrons/opentrons-magnetic-module-firmware/Config.in
```kconfig
config BR2_PACKAGE_OPENTRONS_MAGNETIC_MODULE_FIRMWARE
	bool "opentrons-magnetic-module-firmware"
	help
		Opentrons Magnetic Module Firmware

		Hex file of the current board firmware
		for an Opentrons Magnetic Module

		https://github.com/opentrons/opentrons-modules
```

## package/opentrons/opentrons-temperature-module-firmware/Config.in
```kconfig
config BR2_PACKAGE_OPENTRONS_TEMPERATURE_MODULE_FIRMWARE
	bool "opentrons-temperature-module-firmware"
	help
		Opentrons Temperature Module Firmware

		Hex file of the current board firmware
		for an Opentrons Temperature Module

		https://github.com/opentrons/opentrons-modules
```

## package/opentrons/opentrons-thermocycler-firmware/Config.in
```kconfig
config BR2_PACKAGE_OPENTRONS_THERMOCYCLER_FIRMWARE
	bool "opentrons-thermocycler-firmware"
	help
		Opentrons Thermocycler Firmware

		Binary of the current board firmware
		for an Opentrons Thermocycler

		https://github.com/opentrons/opentrons-modules
```

## package/opentrons/opentrons-thermocycler-gen2-firmware/Config.in
```kconfig
config BR2_PACKAGE_OPENTRONS_THERMOCYCLER_GEN2_FIRMWARE
	bool "opentrons-thermocycler-gen2-firmware"
	help
		Opentrons Thermocycler-Gen2 Firmware

		Binary of the current board firmware
		for an Opentrons Thermocycler Gen2

		https://github.com/opentrons/opentrons-modules
```

## package/python-aiohttp/Config.in
```kconfig
config BR2_PACKAGE_PYTHON_AIOHTTP
	bool "python-aiohttp"
	select BR2_PACKAGE_PYTHON_AIODNS # runtime
	select BR2_PACKAGE_PYTHON_AIOSIGNAL # runtime
	select BR2_PACKAGE_PYTHON_ASYNC_TIMEOUT # runtime
	select BR2_PACKAGE_PYTHON_ATTRS # runtime
	select BR2_PACKAGE_PYTHON_CCHARDET if BR2_INSTALL_LIBSTDCPP # runtime
	select BR2_PACKAGE_PYTHON_CHARDET if !BR2_INSTALL_LIBSTDCPP # runtime
	select BR2_PACKAGE_PYTHON_MULTIDICT # runtime
	select BR2_PACKAGE_PYTHON_TYPING_EXTENSIONS # runtime
	select BR2_PACKAGE_PYTHON_YARL # runtime
	select BR2_PACKAGE_PYTHON3_ZLIB # runtime
	help
	  Async http client/server framework (asyncio).

	  https://github.com/aio-libs/aiohttp

config BR2_PACKAGE_PYTHON_AIOHTTP_SOURCE
        bool "aiohttp.source"
        help
                Include source files (.c, .pyx, .pxd).
                Selecting this option adds about 1 MB to the target file
                system.
```

## package/python-aionotify/Config.in
```kconfig
config BR2_PACKAGE_PYTHON_AIONOTIFY
	bool "python-aionotify"
	depends on BR2_PACKAGE_PYTHON3
	help
	  asyncio interface to inotify.

	  https://github.com/rbarrois/aionotify
```

## package/python-aiosqlite/Config.in
```kconfig
config BR2_PACKAGE_PYTHON_AIOSQLITE
	bool "python-aiosqlite"
	select BR2_PACKAGE_PYTHON_TYPING_EXTENSIONS # runtime
	help
	  asyncio bridge to the standard sqlite3 module.

	  https://aiosqlite.omnilib.dev
```

## package/python-anyio/Config.in
```kconfig
config BR2_PACKAGE_PYTHON_ANYIO
	bool "python-anyio"
	depends on BR2_PACKAGE_PYTHON3
	select BR2_PACKAGE_PYTHON_IDNA # runtime
	select BR2_PACKAGE_PYTHON_SNIFFIO # runtime
	select BR2_PACKAGE_PYTHON_TYPING_EXTENSIONS # runtime
	help
	  High level compatibility layer for multiple asynchronous
	  event loop implementations.

	  
```

## package/python-apply_defaults/Config.in
```kconfig
config BR2_PACKAGE_PYTHON_APPLY_DEFAULTS
	bool "python-apply_defaults"
	help
	  Apply values to optional params.

	  https://github.com/bcb/apply_defaults
```

## package/python-asgiref/Config.in
```kconfig
config BR2_PACKAGE_PYTHON_ASGIREF
	bool "python-asgiref"
	depends on BR2_PACKAGE_PYTHON3
	select BR2_PACKAGE_PYTHON_TYPING_EXTENSIONS # runtime
	help
	  ASGI specs, helper code, and adapters.

	  https://github.com/django/asgiref/
```

## package/python-backportsentry-points-selectable/Config.in
```kconfig
config BR2_PACKAGE_PYTHON_BACKPORTSENTRY_POINTS_SELECTABLE
	bool "python-backportsentry_points_selectable"
	select BR2_PACKAGE_PYTHON_IMPORTLIB_METADATA # runtime
	help
	  Compatibility shim providing selectable entry points for
	  older implementations.

	  https://github.com/jaraco/backports.entry_points_selectable
```

## package/python-bleach/Config.in
```kconfig
config BR2_PACKAGE_PYTHON_BLEACH
	bool "python-bleach"
	select BR2_PACKAGE_PYTHON_SIX # runtime
	select BR2_PACKAGE_PYTHON_WEBENCODINGS # runtime
	help
	  An easy safelist-based HTML-sanitizing tool.

	  https://github.com/mozilla/bleach
```

## package/python-bluepy/Config.in
```kconfig
config BR2_PACKAGE_PYTHON_BLUEPY
	bool "python-bluepy"
	select BR2_PACKAGE_LIBGLIB2
	help
	  Python module for interfacing with BLE devices through
	  Bluez.

	  https://github.com/IanHarvey/bluepy
```

## package/python-cachecontrol/Config.in
```kconfig
config BR2_PACKAGE_PYTHON_CACHECONTROL
	bool "python-cachecontrol"
	select BR2_PACKAGE_PYTHON_REQUESTS # runtime
	select BR2_PACKAGE_PYTHON_MSGPACK # runtime
	help
	  httplib2 caching for requests.

	  https://github.com/ionrock/cachecontrol
```

## package/python-cachy/Config.in
```kconfig
config BR2_PACKAGE_PYTHON_CACHY
	bool "python-cachy"
	help
	  Cachy provides a simple yet effective caching library.

	  https://github.com/sdispater/cachy
```

## package/python-cchardet/Config.in
```kconfig
config BR2_PACKAGE_PYTHON_CCHARDET
	bool "python-cchardet"
	depends on BR2_INSTALL_LIBSTDCPP
	depends on BR2_PACKAGE_HOST_PYTHON_CYTHON
	help
	  cChardet is high speed universal character encoding
	  detector.

	  https://github.com/PyYoshi/cChardet

comment "python-cchardet needs a toolchain w/ C++"
	depends on !BR2_INSTALL_LIBSTDCPP
```

## package/python-certifi/Config.in
```kconfig
config BR2_PACKAGE_PYTHON_CERTIFI
	bool "python-certifi"
	depends on BR2_PACKAGE_PYTHON3
	help
	  Python package for providing Mozilla's CA Bundle.

	  http://certifi.io/
```

## package/python-cleo/Config.in
```kconfig
config BR2_PACKAGE_PYTHON_CLEO
	bool "python-cleo"
	select BR2_PACKAGE_PYTHON_CLIKIT # runtime
	help
	  Cleo allows you to create beautiful and testable command-
	  line interfaces.

	  https://github.com/sdispater/cleo
```

## package/python-click/Config.in
```kconfig
config BR2_PACKAGE_PYTHON_CLICK
	bool "python-click"
	select BR2_PACKAGE_PYTHON_IMPORTLIB_METADATA # runtime
	help
	  Composable command line interface toolkit.

	  https://palletsprojects.com/p/click/
```
